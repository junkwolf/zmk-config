## config/boards/shields/scrollpad/Kconfig.shield
```kconfig
# Copyright (c) 2022 The ZMK Contributors
# SPDX-License-Identifier: MIT

config SHIELD_SCROLLPAD
    def_bool $(shields_list_contains,scrollpad)
```
